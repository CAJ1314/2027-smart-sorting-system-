#include "ILI9341.h"
#include "Delay.h"

/* ================================================================
   LVSN-TFT-2.4  ILI9341  240x320  四线SPI
   Software SPI: PE9=SDI, PE8=CLK, SDO disconnected
   GPIO: PG1=CS, PF15=DC, BLK remains on its existing supply
   ================================================================ */

#define ILI9341_SDI_PORT     GPIOE
#define ILI9341_SDI_PIN      GPIO_Pin_9
#define ILI9341_CLK_PORT     GPIOE
#define ILI9341_CLK_PIN      GPIO_Pin_8
#define ILI9341_CS_PORT      GPIOG
#define ILI9341_CS_PIN       GPIO_Pin_1
#define ILI9341_DC_PORT      GPIOF
#define ILI9341_DC_PIN       GPIO_Pin_15

#define ILI9341_DC_LOW()     GPIO_ResetBits(ILI9341_DC_PORT, ILI9341_DC_PIN)
#define ILI9341_DC_HIGH()    GPIO_SetBits(ILI9341_DC_PORT, ILI9341_DC_PIN)

/* ================================================================
   8x16 ASCII 字库 (0x20 ~ 0x7E, 共95字符, 每字符16字节)
   ================================================================ */
static const uint8_t FONT_8x16[95][16] = {
    {0x00,0x00,0x00,0x00,0x00,0x00,0x00,0x00,0x00,0x00,0x00,0x00,0x00,0x00,0x00,0x00}, /*   */
    {0x00,0x00,0x00,0xF8,0x00,0x00,0x00,0x00,0x00,0x00,0x00,0x33,0x30,0x00,0x00,0x00}, /* ! */
    {0x00,0x10,0x0C,0x06,0x10,0x0C,0x06,0x00,0x00,0x00,0x00,0x00,0x00,0x00,0x00,0x00}, /* " */
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    {0x00,0x06,0x01,0x01,0x02,0x02,0x04,0x04,0x00,0x00,0x00,0x00,0x00,0x00,0x00,0x00}, /* ~ */
};

/* ================================================================
   SPI 底层
   ================================================================ */
/* Software SPI mode 0: SDI=PE9, CLK=PE8, CS=PG1, DC=PF15.
 * SDO is disconnected; no display readback is required. */
static void SPI_WriteByte(uint8_t data)
{
    uint8_t bit;
    for (bit = 0; bit < 8; bit++) {
        GPIO_ResetBits(ILI9341_CLK_PORT, ILI9341_CLK_PIN);
        if (data & 0x80) GPIO_SetBits(ILI9341_SDI_PORT, ILI9341_SDI_PIN);
        else GPIO_ResetBits(ILI9341_SDI_PORT, ILI9341_SDI_PIN);
        Delay_us(1);
        GPIO_SetBits(ILI9341_CLK_PORT, ILI9341_CLK_PIN);
        Delay_us(1);
        data <<= 1;
    }
    GPIO_ResetBits(ILI9341_CLK_PORT, ILI9341_CLK_PIN);
}

static void ILI9341_SPI_Init(void)
{
    GPIO_InitTypeDef g;
    RCC_AHB1PeriphClockCmd(RCC_AHB1Periph_GPIOE | RCC_AHB1Periph_GPIOG |
                           RCC_AHB1Periph_GPIOF, ENABLE);
    GPIO_StructInit(&g);
    g.GPIO_Mode = GPIO_Mode_OUT;
    g.GPIO_Speed = GPIO_Speed_50MHz;
    g.GPIO_OType = GPIO_OType_PP;
    g.GPIO_PuPd = GPIO_PuPd_NOPULL;
    GPIO_SetBits(ILI9341_CS_PORT, ILI9341_CS_PIN);
    GPIO_ResetBits(ILI9341_CLK_PORT, ILI9341_CLK_PIN);
    g.GPIO_Pin = ILI9341_CLK_PIN | ILI9341_SDI_PIN;
    GPIO_Init(ILI9341_CLK_PORT, &g);
    g.GPIO_Pin = ILI9341_CS_PIN;
    GPIO_Init(ILI9341_CS_PORT, &g);
    g.GPIO_Pin = ILI9341_DC_PIN;
    GPIO_Init(ILI9341_DC_PORT, &g);
    ILI9341_CS_HIGH();
    ILI9341_DC_HIGH();
}

/* ================================================================
   ILI9341 底层写操作
   ================================================================ */
void ILI9341_WriteCmd(uint8_t cmd)
{
    ILI9341_DC_LOW();
    ILI9341_CS_LOW();
    SPI_WriteByte(cmd);
    ILI9341_CS_HIGH();
}

void ILI9341_WriteData(uint8_t data)
{
    ILI9341_DC_HIGH();
    ILI9341_CS_LOW();
    SPI_WriteByte(data);
    ILI9341_CS_HIGH();
}

void ILI9341_WriteData16(uint16_t data)
{
    ILI9341_DC_HIGH();
    ILI9341_CS_LOW();
    SPI_WriteByte((uint8_t)(data >> 8));
    SPI_WriteByte((uint8_t)(data & 0xFF));
    ILI9341_CS_HIGH();
}

/* ================================================================
   ILI9341 初始化序列
   ================================================================ */
void ILI9341_Init(void)
{
    ILI9341_SPI_Init();

    /* 软件复位 */
    ILI9341_WriteCmd(0x01);
    Delay_ms(120);

    ILI9341_WriteCmd(0xCB); ILI9341_WriteData(0x39); ILI9341_WriteData(0x2C);
    ILI9341_WriteData(0x00); ILI9341_WriteData(0x34); ILI9341_WriteData(0x02);

    ILI9341_WriteCmd(0xCF); ILI9341_WriteData(0x00); ILI9341_WriteData(0xC1);
    ILI9341_WriteData(0x30);

    ILI9341_WriteCmd(0xE8); ILI9341_WriteData(0x85); ILI9341_WriteData(0x00);
    ILI9341_WriteData(0x78);

    ILI9341_WriteCmd(0xEA); ILI9341_WriteData(0x00); ILI9341_WriteData(0x00);

    ILI9341_WriteCmd(0xED); ILI9341_WriteData(0x64); ILI9341_WriteData(0x03);
    ILI9341_WriteData(0x12); ILI9341_WriteData(0x81);

    ILI9341_WriteCmd(0xF7); ILI9341_WriteData(0x20);

    ILI9341_WriteCmd(0xC0); ILI9341_WriteData(0x23);
    ILI9341_WriteCmd(0xC1); ILI9341_WriteData(0x10);
    ILI9341_WriteCmd(0xC5); ILI9341_WriteData(0x3E); ILI9341_WriteData(0x28);
    ILI9341_WriteCmd(0xC7); ILI9341_WriteData(0x86);

    ILI9341_WriteCmd(0x36); ILI9341_WriteData(0x48);
    ILI9341_WriteCmd(0x3A); ILI9341_WriteData(0x55);

    ILI9341_WriteCmd(0xB1); ILI9341_WriteData(0x00); ILI9341_WriteData(0x18);

    ILI9341_WriteCmd(0xB6); ILI9341_WriteData(0x08); ILI9341_WriteData(0x82);
    ILI9341_WriteData(0x27);

    ILI9341_WriteCmd(0xF2); ILI9341_WriteData(0x00);
    ILI9341_WriteCmd(0x26); ILI9341_WriteData(0x01);

    ILI9341_WriteCmd(0xE0);
    ILI9341_WriteData(0x0F); ILI9341_WriteData(0x31); ILI9341_WriteData(0x2B);
    ILI9341_WriteData(0x0C); ILI9341_WriteData(0x0E); ILI9341_WriteData(0x08);
    ILI9341_WriteData(0x4E); ILI9341_WriteData(0xF1); ILI9341_WriteData(0x37);
    ILI9341_WriteData(0x07); ILI9341_WriteData(0x10); ILI9341_WriteData(0x03);
    ILI9341_WriteData(0x0E); ILI9341_WriteData(0x09); ILI9341_WriteData(0x00);

    ILI9341_WriteCmd(0xE1);
    ILI9341_WriteData(0x00); ILI9341_WriteData(0x0E); ILI9341_WriteData(0x14);
    ILI9341_WriteData(0x03); ILI9341_WriteData(0x11); ILI9341_WriteData(0x07);
    ILI9341_WriteData(0x31); ILI9341_WriteData(0xC1); ILI9341_WriteData(0x48);
    ILI9341_WriteData(0x08); ILI9341_WriteData(0x0F); ILI9341_WriteData(0x0C);
    ILI9341_WriteData(0x31); ILI9341_WriteData(0x36); ILI9341_WriteData(0x0F);

    /* 退出睡眠 */
    ILI9341_WriteCmd(0x11);
    Delay_ms(120);

    /* 开显示 */
    ILI9341_WriteCmd(0x29);
    Delay_ms(20);
}

/* ================================================================
   绘图函数
   ================================================================ */

void ILI9341_SetWindow(uint16_t x1, uint16_t y1, uint16_t x2, uint16_t y2)
{
    ILI9341_WriteCmd(0x2A);
    ILI9341_WriteData16(x1);
    ILI9341_WriteData16(x2);

    ILI9341_WriteCmd(0x2B);
    ILI9341_WriteData16(y1);
    ILI9341_WriteData16(y2);

    ILI9341_WriteCmd(0x2C);
}

void ILI9341_FillScreen(uint16_t color)
{
    ILI9341_FillRect(0, 0, ILI9341_WIDTH, ILI9341_HEIGHT, color);
}

void ILI9341_FillRect(uint16_t x, uint16_t y, uint16_t w, uint16_t h, uint16_t color)
{
    uint32_t n = (uint32_t)w * h;

    if (x + w > ILI9341_WIDTH)  return;
    if (y + h > ILI9341_HEIGHT) return;

    ILI9341_SetWindow(x, y, x + w - 1, y + h - 1);

    ILI9341_DC_HIGH();
    ILI9341_CS_LOW();
    while (n--)
    {
        SPI_WriteByte((uint8_t)(color >> 8));
        SPI_WriteByte((uint8_t)(color & 0xFF));
    }
    ILI9341_CS_HIGH();
}

/* ================================================================
   文字绘制 (8x16 ASCII, 支持 1x/2x 缩放)
   ================================================================ */

static void ILI9341_DrawChar(uint16_t x, uint16_t y, char ch,
                             uint16_t color, uint16_t bg, uint8_t scale)
{
    uint8_t col, row, sy, sx;

    if (ch < 0x20 || ch > 0x7E) return;

    const uint8_t *p = FONT_8x16[ch - 0x20];

    ILI9341_FillRect(x, y, 8 * scale, 16 * scale, bg);

    ILI9341_SetWindow(x, y, x + 8 * scale - 1, y + 16 * scale - 1);
    ILI9341_DC_HIGH();
    ILI9341_CS_LOW();

    /* This FONT_8x16 table is column-major: p[(row/8)*8 + col] is one column
       of an 8-row band and bit0 is that band's top pixel. Reading p[row]
       with bit7 would render garbage. */
    for (row = 0; row < 16; row++)
    {
        for (sy = 0; sy < scale; sy++)
        {
            for (col = 0; col < 8; col++)
            {
                uint16_t c = (p[(row / 8) * 8 + col] >> (row % 8)) & 0x01 ? color : bg;
                for (sx = 0; sx < scale; sx++)
                {
                    SPI_WriteByte((uint8_t)(c >> 8));
                    SPI_WriteByte((uint8_t)(c & 0xFF));
                }
            }
        }
    }

    ILI9341_CS_HIGH();
}

void ILI9341_DrawString(uint16_t x, uint16_t y, const char *str,
                        uint16_t color, uint16_t bg, uint8_t scale)
{
    while (*str)
    {
        ILI9341_DrawChar(x, y, *str, color, bg, scale);
        x += 8 * scale;
        if (x + 8 * scale > ILI9341_WIDTH) { x = 0; y += 16 * scale; }
        str++;
    }
}

/* Image2LCD: RGB565, horizontal scan, no header, high byte first.
 * Reject invalid length and bounds before writing to the display. */
void ILI9341_DrawImageRGB565(uint16_t x, uint16_t y,
    uint16_t w, uint16_t h, const uint8_t *pixels, uint32_t length)
{
    uint32_t i, needed;
    if (!pixels || !w || !h || x >= ILI9341_WIDTH || y >= ILI9341_HEIGHT) return;
    if (w > ILI9341_WIDTH - x || h > ILI9341_HEIGHT - y) return;
    needed = (uint32_t)w * h * 2u;
    if (length != needed) return;
    ILI9341_SetWindow(x, y, x + w - 1, y + h - 1);
    ILI9341_DC_HIGH();
    ILI9341_CS_LOW();
    for (i = 0; i < needed; i++) SPI_WriteByte(pixels[i]);
    ILI9341_CS_HIGH();
}
